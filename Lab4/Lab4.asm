 include <p16f887.inc>
Counter EQU 0x45


 ORG 0 
 goto init 
 ORG 4
 goto isr

 ORG 5

init: 

	BANKSEL OSCCON
	BCF OSCCON, 0x05
	BCF OSCCON, 0x06
	BCF OSCCON, 0x04

	BANKSEL OPTION_REG
	BSF OPTION_REG, 0x05
	BSF OPTION_REG, 0x02
	BSF OPTION_REG, 0x01
	BSF OPTION_REG, 0x00

	BANKSEL ANSELH 
	CLRF ANSELH 

	BANKSEL ANSEL
	CLRF ANSEL

	BANKSEL IOCB   
	BSF IOCB, 0x00

	BANKSEL INTCON 
	BSF INTCON, 0x03
	BSF INTCON, 0x04
	BCF INTCON, 0x05
	BSF INTCON, 0x07


	BANKSEL TRISB  
	MOVLW 0x01
	MOVWF TRISB

	
	BANKSEL PORTB  
	CLRF PORTB


	CLRF 0x21

	goto main

main: 

	NOP
	goto main


isr: 

	BANKSEL OPTION_REG
	BCF OPTION_REG, 0x05

	BANKSEL TMR0
	CLRF TMR0
	MOVLW 0x0B
	MOVWF TMR0
	BSF INTCON, 0x05

delay:
	
	BTFSC INTCON, T0IF
	goto isrI
	
	goto delay
	

isrI: 
	
	INCF 0x21
	MOVFW 0x21
	MOVWF 0x22
	RLF 0x22
	MOVFW 0x22
	MOVWF PORTB

	BANKSEL OPTION_REG
	BSF OPTION_REG, 0x05

	BCF INTCON, T0IF
	BCF INTCON, 0x05
	BCF INTCON, 0
	BCF INTCON, 1

	RETFIE

 END
	